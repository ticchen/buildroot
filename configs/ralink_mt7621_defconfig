## configs/ralink_mt7621_defconfig
```kconfig
BR2_mipsel=y
BR2_mips_32r2=y
BR2_HOST_DIR="/opt/buildroot-gcc493"
BR2_CCACHE=y
BR2_CCACHE_DIR="~/.ccache"
BR2_KERNEL_HEADERS_VERSION=y
BR2_DEFAULT_KERNEL_VERSION="2.6.36"
BR2_TOOLCHAIN_BUILDROOT_INET_RPC=y
BR2_TOOLCHAIN_BUILDROOT_WCHAR=y
BR2_TOOLCHAIN_BUILDROOT_CXX=y
BR2_GCC_ENABLE_LTO=y
```
